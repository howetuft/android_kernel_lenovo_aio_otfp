## sound/soc/mediatek/Kconfig
```kconfig
config MT_SND_SOC_V1
    tristate "MT_SND_SOC_V1"
    default n
    help
        If you say Y, enable MT_SND_SOC_V1_driver.
config MT_SND_SOC_V2
    tristate "MT_SND_SOC_V2"
	default n
	help
        If you say Y, enable MT_SND_SOC_V2_driver.
config MT_SND_SOC_V3
    tristate "MT_SND_SOC_V3"
	default n
	help
        If you say Y, enable MT_SND_SOC_V3_driver.				
config MT_SND_SOC_6580
    tristate "MT_SND_SOC_6580"
	default n
	help
        If you say Y, enable MT_SND_SOC_6580_driver.
config MT_SND_SOC_8163
    tristate "MT_SND_SOC_8163"
	default n
	help
        If you say Y, enable MT_SND_SOC_8163_driver.
config MTK_SPEAKER
    tristate "MTK_SPEAKER"
	default n
	help
	  If you say Y, enable MTK_SPEAKER_AMP
config MTK_NXP_TFA9890
    tristate "MTK_NXP_TFA9890"
	default n
	help
        If you say Y, enable MTK_NXP_TFA9890 driver.
config LENOVO_PIEZO
    tristate "LENOVO_PIEZO"
	default n
	help
        If you say Y, enable CONFIG_LENOVO_PIEZO driver.
config AIO_ROW_HEADPHONES_SWITCH
   tristate "AIO_ROW_HEADPHONES_SWITCH"
        default n
        help
        If you say Y, enable AIO_ROW_HEADPHONES_SWITCH function
config MTK_NXP_TFA9897
    tristate "MTK_NXP_TFA9897"
	default n
	help
        If you say Y, enable MTK_NXP_TFA9897 driver.


config SND_SOC_MEDIATEK
	tristate "ASoC support for Mediatek chip"
	depends on MEDIATEK_SOLUTION
	help
	  This adds ASoC platform driver support for Mediatek chip
	  that can be used with other codecs.
	  Select Y if you have such device.
	  Ex: MT8173

config SND_SOC_MT8173
	tristate "ASoC support for Mediatek MT8173 chip"
	depends on MEDIATEK_SOLUTION
	select SND_SOC_MEDIATEK
	help
	  This adds ASoC platform driver support for Mediatek MT8173 chip
	  that can be used with other codecs.
	  Select Y if you have such device.
	  Ex: MT8173

config SND_SOC_MT8173_MAX98090
	tristate "ASoC Audio driver for MT8173 with MAX98090 codec"
	depends on MEDIATEK_SOLUTION
	select SND_SOC_MAX98090
	help
	  This adds ASoC driver for Mediatek MT8173 boards
	  with the MAX98090 audio codec.
	  Select Y if you have such device.
	  If unsure select "N".

config SND_SOC_MT8173_RT5650_RT5676
	tristate "ASoC Audio driver for MT8173 with RT5650 RT5676 codecs"
	depends on MEDIATEK_SOLUTION
	select SND_SOC_RT5645
	select SND_SOC_RT5677
	help
	  This adds ASoC driver for Mediatek MT8173 boards
	  with the RT5650 and RT5676 codecs.
	  Select Y if you have such device.
	  If unsure select "N".
```
